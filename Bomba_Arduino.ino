/*  OLED          arduino
     D0-----------10  D10
     D1-----------9   D9
     RST----------13  D13
     DC-----------11  D11
     VCC----------5V
     GND----------GND
     
OLED     Arduino
----------------
SDA      D9
SCL      D10
RST      D13
DC       D11
VCC      5V
GND      GND
     */

#include <avr/pgmspace.h>
#include <TimerOne.h>


#define SCL_PIN 10    /* OLED D0 or SCL, Arduino D10 */
#define SDA_PIN 9     /* LED D1 or SDA, Arduino D9 */
#define RST_PIN 13    /* OLED RST */
#define DC_PIN  11    /* OLED DC */

#define TIMEOUT 600   /* 10 minutos para explosao */
#define BUZZER  4     /* pino do buzzer*/
#define LED_PIN 5     /*LED da explosao*/


#define POTENTIOMETER_1 A0
#define INTERRUPT_PIN   2

int value             = 0;
int toMap             = 0;
int number            = 0;
int pos               = 0;
int timeout           = TIMEOUT; //decrementa até a explosao
int picos_e_tombos[2] = {0}; //0 picos, 1 tombos
bool enter            = false;
bool locked           = false;
bool started          = false;
bool finished         = false;
bool do_explosion     = false;
char numbers[5]       = {' '};
//char compareWith[4]   = {'\0'};
char password[5]      = {'\0'};
char buf_t[5]         = {0};
String time_to_show   = "00:00";
String pt_time        = "";
String msg_status     = "Selecione senha";


static int move_offset;
static int move_counter;

unsigned int DATA = 0, old_DATA = 0;

int key_choose = -1;
int old_key_choose = -1;

void LED_CLS(void);
void LED_Set_Pos(unsigned char x, unsigned char y); //Set the coordinate
void LED_WrDat(unsigned char data);   //Write Data
void LED_P8x16Str(unsigned char x, unsigned char y, unsigned char ch[]);
void LED_Fill(unsigned char dat);

int keyPressed(){
  int val = 0;
}

const unsigned char F8X16[] PROGMEM = {
  0x00, 0x00, 0x00, 0x00, 0x00, 0x00, 0x00, 0x00, 0x00, 0x00, 0x00, 0x00, 0x00, 0x00, 0x00, 0x00, // 0
  0x00, 0x00, 0x00, 0xF8, 0x00, 0x00, 0x00, 0x00, 0x00, 0x00, 0x00, 0x33, 0x30, 0x00, 0x00, 0x00, //!1
  0x00, 0x10, 0x0C, 0x06, 0x10, 0x0C, 0x06, 0x00, 0x00, 0x00, 0x00, 0x00, 0x00, 0x00, 0x00, 0x00, //"2
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  0x00, 0x06, 0x01, 0x01, 0x02, 0x02, 0x04, 0x04, 0x00, 0x00, 0x00, 0x00, 0x00, 0x00, 0x00, 0x00, //~94
};


const unsigned char F23x32[] PROGMEM = { 
  // 0
  0x00, 0x00, 0x80, 0xE0, 0xF8, 0xFC, 0xFC, 0xFE, 0x7E, 0x3E, 0x3E, 0x3E, 0x3E, 0x3E, 0x7E, 0xFE, 0xFC, 0xFC, 0xF8, 0xE0, 0x80, 0x00, 0x00,
  0x00, 0xFC, 0xFF, 0xFF, 0xFF, 0xFF, 0xFF, 0x03, 0x00, 0x00, 0x00, 0x00, 0x00, 0x00, 0x00, 0x03, 0xFF, 0xFF, 0xFF, 0xFF, 0xFF, 0xFC, 0x00,
  0x00, 0x7F, 0xFF, 0xFF, 0xFF, 0xFF, 0xFF, 0x80, 0x00, 0x00, 0x00, 0x00, 0x00, 0x00, 0x00, 0x80, 0xFF, 0xFF, 0xFF, 0xFF, 0xFF, 0x7F, 0x00,
  0x00, 0x00, 0x03, 0x0F, 0x3F, 0x7F, 0x7F, 0xFF, 0xFC, 0xF8, 0xF8, 0xF8, 0xF8, 0xF8, 0xFC, 0xFF, 0x7F, 0x7F, 0x3F, 0x0F, 0x03, 0x00, 0x00,
  // 1
  0x00, 0x00, 0xF8, 0xFC, 0xFC, 0x7C, 0x7C, 0x7E, 0x7E, 0xFE, 0xFE, 0xFE, 0xFE, 0xFE, 0xFE, 0x00, 0x00, 0x00, 0x00, 0x00, 0x00, 0x00, 0x00,
  0x00, 0x00, 0x00, 0x00, 0x00, 0x00, 0x00, 0x00, 0x00, 0xFF, 0xFF, 0xFF, 0xFF, 0xFF, 0xFF, 0x00, 0x00, 0x00, 0x00, 0x00, 0x00, 0x00, 0x00,
  0x00, 0x00, 0x00, 0x00, 0x00, 0x00, 0x00, 0x00, 0x00, 0xFF, 0xFF, 0xFF, 0xFF, 0xFF, 0xFF, 0x00, 0x00, 0x00, 0x00, 0x00, 0x00, 0x00, 0x00,
  0x00, 0x00, 0xF8, 0xF8, 0xF8, 0xF8, 0xF8, 0xF8, 0xF8, 0xFF, 0xFF, 0xFF, 0xFF, 0xFF, 0xFF, 0xF8, 0xF8, 0xF8, 0xF8, 0xF8, 0xF8, 0xF8, 0x00,
  // 2
  0x00, 0xFC, 0x7C, 0x7E, 0x3E, 0x3E, 0x3E, 0x3E, 0x3E, 0x3E, 0x3E, 0x3E, 0x7E, 0xFE, 0xFE, 0xFC, 0xFC, 0xF8, 0xF0, 0xC0, 0x00, 0x00, 0x00,
  0x00, 0x00, 0x00, 0x00, 0x00, 0x00, 0x00, 0x00, 0x00, 0x00, 0x00, 0x80, 0xC0, 0xF0, 0xFF, 0xFF, 0xFF, 0xFF, 0x3F, 0x0F, 0x00, 0x00, 0x00,
  0x00, 0x00, 0x00, 0x00, 0x80, 0xC0, 0xF0, 0xF8, 0xFC, 0xFE, 0x7F, 0x3F, 0x1F, 0x0F, 0x07, 0x03, 0x01, 0x00, 0x00, 0x00, 0x00, 0x00, 0x00,
  0x00, 0xFC, 0xFE, 0xFF, 0xFF, 0xFF, 0xFF, 0xFB, 0xF9, 0xF8, 0xF8, 0xF8, 0xF8, 0xF8, 0xF8, 0xF8, 0xF8, 0xF8, 0xF8, 0xF8, 0x00, 0x00, 0x00,
  // 3
  0x7C, 0x7C, 0x7E, 0x7E, 0x3E, 0x3E, 0x3E, 0x3E, 0x3E, 0x3E, 0x3E, 0x3E, 0x3E, 0x7E, 0xFE, 0xFC, 0xFC, 0xF8, 0xF0, 0xC0, 0x00, 0x00, 0x00,
  0x00, 0x00, 0x00, 0x00, 0x00, 0x00, 0xE0, 0xE0, 0xE0, 0xE0, 0xE0, 0xE0, 0xF0, 0xF8, 0x7F, 0x7F, 0x3F, 0x3F, 0x1F, 0x07, 0x00, 0x00, 0x00,
  0x00, 0x00, 0x00, 0x00, 0x00, 0x00, 0x03, 0x03, 0x03, 0x03, 0x03, 0x03, 0x07, 0x07, 0x1F, 0xFF, 0xFF, 0xFE, 0xFE, 0xFC, 0xF0, 0x00, 0x00,
  0x00, 0x7C, 0xFC, 0xF8, 0xF8, 0xF8, 0xF8, 0xF8, 0xF8, 0xF8, 0xF8, 0xF8, 0xF8, 0xFC, 0xFE, 0xFF, 0x7F, 0x7F, 0x3F, 0x1F, 0x07, 0x00, 0x00,
  // 4
  0x00, 0x00, 0x00, 0x00, 0x00, 0x00, 0x00, 0x00, 0x80, 0xE0, 0xF0, 0xFC, 0xFE, 0xFE, 0xFE, 0xFE, 0xFE, 0xFE, 0xFE, 0x00, 0x00, 0x00, 0x00,
  0x00, 0x00, 0x00, 0x80, 0xE0, 0xF0, 0xFC, 0xFE, 0x7F, 0x1F, 0x0F, 0x03, 0x01, 0xFF, 0xFF, 0xFF, 0xFF, 0xFF, 0xFF, 0x00, 0x00, 0x00, 0x00,
  0x00, 0xFC, 0xFF, 0xFF, 0xFF, 0xF7, 0xF3, 0xF0, 0xF0, 0xF0, 0xF0, 0xF0, 0xF0, 0xFF, 0xFF, 0xFF, 0xFF, 0xFF, 0xFF, 0xF0, 0xF0, 0xF0, 0xF0,
  0x00, 0x01, 0x01, 0x01, 0x01, 0x01, 0x01, 0x01, 0x01, 0x01, 0x01, 0x01, 0x01, 0xFF, 0xFF, 0xFF, 0xFF, 0xFF, 0xFF, 0x01, 0x01, 0x01, 0x01,
  // 5
  0x00, 0x00, 0xFE, 0xFE, 0xFE, 0xFE, 0xFE, 0x3E, 0x3E, 0x3E, 0x3E, 0x3E, 0x3E, 0x3E, 0x3E, 0x3E, 0x3E, 0x3E, 0x3E, 0x00, 0x00, 0x00, 0x00,
  0x00, 0x00, 0xFF, 0xFF, 0xFF, 0xFF, 0xFF, 0xF8, 0xF8, 0xF8, 0xF8, 0xF8, 0xF8, 0xF8, 0xF0, 0xF0, 0xE0, 0xE0, 0xC0, 0x00, 0x00, 0x00, 0x00,
  0x00, 0x00, 0x03, 0x01, 0x01, 0x00, 0x00, 0x00, 0x00, 0x00, 0x00, 0x00, 0x01, 0x03, 0x07, 0xFF, 0xFF, 0xFF, 0xFF, 0xFF, 0xFC, 0x00, 0x00,
  0x00, 0x7C, 0xFC, 0xF8, 0xF8, 0xF8, 0xF8, 0xF8, 0xF8, 0xF8, 0xF8, 0xF8, 0xF8, 0xFC, 0xFF, 0x7F, 0x7F, 0x3F, 0x1F, 0x0F, 0x01, 0x00, 0x00,
  // 6
  0x00, 0x00, 0x80, 0xE0, 0xF0, 0xF8, 0xFC, 0xFC, 0xFE, 0x7E, 0x3E, 0x3E, 0x3E, 0x3E, 0x3E, 0x3E, 0x3E, 0x3E, 0x3E, 0x7C, 0x00, 0x00, 0x00,
  0x00, 0xF8, 0xFF, 0xFF, 0xFF, 0xFF, 0xFF, 0xE3, 0xF0, 0xF0, 0xF8, 0xF8, 0xF8, 0xF8, 0xF8, 0xF8, 0xF0, 0xF0, 0xE0, 0xC0, 0x80, 0x00, 0x00,
  0x00, 0x7F, 0xFF, 0xFF, 0xFF, 0xFF, 0xFF, 0xFF, 0x03, 0x01, 0x00, 0x00, 0x00, 0x00, 0x01, 0x07, 0xFF, 0xFF, 0xFF, 0xFF, 0xFF, 0xFE, 0x00,
  0x00, 0x00, 0x07, 0x1F, 0x3F, 0x7F, 0x7F, 0xFF, 0xFC, 0xF8, 0xF8, 0xF8, 0xF8, 0xF8, 0xF8, 0xFE, 0xFF, 0x7F, 0x3F, 0x1F, 0x0F, 0x03, 0x00,
  // 7
  0x00, 0x3E, 0x3E, 0x3E, 0x3E, 0x3E, 0x3E, 0x3E, 0x3E, 0x3E, 0x3E, 0x3E, 0x3E, 0x3E, 0xFE, 0xFE, 0xFE, 0xFE, 0xFE, 0xFE, 0x3E, 0x00, 0x00,
  0x00, 0x00, 0x00, 0x00, 0x00, 0x00, 0x00, 0x00, 0x00, 0x00, 0x80, 0xE0, 0xFC, 0xFF, 0xFF, 0xFF, 0xFF, 0x3F, 0x07, 0x01, 0x00, 0x00, 0x00,
  0x00, 0x00, 0x00, 0x00, 0x00, 0x00, 0x00, 0x80, 0xF0, 0xFC, 0xFF, 0xFF, 0xFF, 0xFF, 0x1F, 0x07, 0x00, 0x00, 0x00, 0x00, 0x00, 0x00, 0x00,
  0x00, 0x00, 0x00, 0x00, 0xC0, 0xF0, 0xFE, 0xFF, 0xFF, 0xFF, 0xFF, 0x1F, 0x03, 0x00, 0x00, 0x00, 0x00, 0x00, 0x00, 0x00, 0x00, 0x00, 0x00,
  // 8
  0x00, 0x00, 0xC0, 0xF0, 0xF8, 0xFC, 0xFE, 0xFE, 0x7E, 0x3E, 0x3E, 0x3E, 0x3E, 0x3E, 0x7E, 0xFE, 0xFE, 0xFC, 0xF8, 0xF0, 0xC0, 0x00, 0x00,
  0x00, 0x00, 0x0F, 0x1F, 0x3F, 0x7F, 0x7F, 0xFF, 0xF8, 0xF0, 0xE0, 0xE0, 0xE0, 0xF0, 0xF8, 0xFF, 0x7F, 0x7F, 0x3F, 0x1F, 0x07, 0x00, 0x00,
  0x00, 0xF0, 0xFC, 0xFE, 0xFF, 0xFF, 0xFF, 0x0F, 0x07, 0x03, 0x03, 0x03, 0x03, 0x03, 0x07, 0x0F, 0xFF, 0xFF, 0xFF, 0xFE, 0xFC, 0xF0, 0x00,
  0x00, 0x07, 0x1F, 0x3F, 0x7F, 0x7F, 0xFF, 0xFE, 0xFC, 0xF8, 0xF8, 0xF8, 0xF8, 0xF8, 0xFC, 0xFE, 0xFF, 0x7F, 0x7F, 0x3F, 0x1F, 0x07, 0x00,
  // 9
  0xE0, 0xE0, 0xF8, 0xFC, 0xFC, 0xFE, 0xFE, 0x3E, 0x3E, 0x3E, 0x3E, 0x3E, 0x3E, 0x7E, 0xFE, 0xFC, 0xFC, 0xF8, 0xF0, 0xC0, 0x00, 0x00, 0x00,
  0xFF, 0xFF, 0xFF, 0xFF, 0xFF, 0xFF, 0xC0, 0x80, 0x00, 0x00, 0x00, 0x00, 0x80, 0xC0, 0xFF, 0xFF, 0xFF, 0xFF, 0xFF, 0xFF, 0xFC, 0x00, 0x00,
  0x00, 0x01, 0x07, 0x0F, 0x0F, 0x0F, 0x1F, 0x1F, 0x1F, 0x1F, 0x1F, 0x1F, 0x0F, 0x0F, 0xC7, 0xFF, 0xFF, 0xFF, 0xFF, 0xFF, 0x3F, 0x00, 0x00,
  0x00, 0x7c, 0x7C, 0xFC, 0xF8, 0xF8, 0xF8, 0xF8, 0xF8, 0xF8, 0xF8, 0xF8, 0xFC, 0xFE, 0x7F, 0x7F, 0x3F, 0x1F, 0x0F, 0x03, 0x00, 0x00, 0x00,
  /* - */
  0x00, 0x00, 0x00, 0x00, 0x00, 0x00, 0x00, 0x00, 0x00, 0x00, 0x00, 0x00, 0x00, 0x00, 0x00, 0x00, 0x00, 0x00, 0x00, 0x00, 0x00, 0x00, 0x00,
  0x00, 0x00, 0x00, 0x00, 0xE0, 0xE0, 0xE0, 0xE0, 0xE0, 0xE0, 0xE0, 0xE0, 0xE0, 0xE0, 0xE0, 0xE0, 0xE0, 0x00, 0x00, 0x00, 0x00, 0x00, 0x00,
  0x00, 0x00, 0x00, 0x00, 0x07, 0x07, 0x07, 0x07, 0x07, 0x07, 0x07, 0x07, 0x07, 0x07, 0x07, 0x07, 0x07, 0x00, 0x00, 0x00, 0x00, 0x00, 0x00,
  0x00, 0x00, 0x00, 0x00, 0x00, 0x00, 0x00, 0x00, 0x00, 0x00, 0x00, 0x00, 0x00, 0x00, 0x00, 0x00, 0x00, 0x00, 0x00, 0x00, 0x00, 0x00, 0x00,
  /* deg */
  0x00, 0x00, 0x00, 0xC0, 0xF0, 0xF8, 0xF8, 0x7C, 0x1C, 0x1C, 0x1C, 0x1C, 0x1C, 0x7C, 0xF8, 0xF8, 0xF0, 0xC0, 0x00, 0x00, 0x00, 0x00, 0x00,
  0x00, 0x00, 0x00, 0x1F, 0x7F, 0xFF, 0xFF, 0xE0, 0xC0, 0x80, 0x80, 0x80, 0xC0, 0xE0, 0xFF, 0xFF, 0x7F, 0x1F, 0x00, 0x00, 0x00, 0x00, 0x00,
  0x00, 0x00, 0x00, 0x00, 0x00, 0x00, 0x01, 0x01, 0x03, 0x03, 0x03, 0x03, 0x03, 0x01, 0x01, 0x00, 0x00, 0x00, 0x00, 0x00, 0x00, 0x00, 0x00,
  0x00, 0x00, 0x00, 0x00, 0x00, 0x00, 0x00, 0x00, 0x00, 0x00, 0x00, 0x00, 0x00, 0x00, 0x00, 0x00, 0x00, 0x00, 0x00, 0x00, 0x00, 0x00, 0x00,
  /* C */
  0x00, 0x00, 0x00, 0xC0, 0xF0, 0xF8, 0xF8, 0xFC, 0xFE, 0x7E, 0x7E, 0x3E, 0x3E, 0x3E, 0x3E, 0x3E, 0x3E, 0x3E, 0x7E, 0xFE, 0xFC, 0x00, 0x00,
  0x00, 0xF8, 0xFF, 0xFF, 0xFF, 0xFF, 0xFF, 0x07, 0x01, 0x00, 0x00, 0x00, 0x00, 0x00, 0x00, 0x00, 0x00, 0x00, 0x00, 0x00, 0x00, 0x00, 0x00,
  0x00, 0x3F, 0xFF, 0xFF, 0xFF, 0xFF, 0xFF, 0xC0, 0x00, 0x00, 0x00, 0x00, 0x00, 0x00, 0x00, 0x00, 0x00, 0x00, 0x00, 0x00, 0x00, 0x00, 0x00,
  0x00, 0x00, 0x01, 0x07, 0x1F, 0x3F, 0x3F, 0x7F, 0xFF, 0xFC, 0xF8, 0xF8, 0xF8, 0xF8, 0xF8, 0xF8, 0xF8, 0xF8, 0xFC, 0xFE, 0x7E, 0x00, 0x00,
  /* . */
  0x00, 0x00, 0x00, 0x00, 0x00, 0x00, 0x00, 0x00, 0x00, 0x00, 0x00, 0x00, 0x00, 0x00, 0x00, 0x00, 0x00, 0x00, 0x00, 0x00, 0x00, 0x00, 0x00,
  0x00, 0x00, 0x00, 0x00, 0x00, 0x00, 0x00, 0x00, 0x00, 0x00, 0x00, 0x00, 0x00, 0x00, 0x00, 0x00, 0x00, 0x00, 0x00, 0x00, 0x00, 0x00, 0x00,
  0x00, 0x00, 0x00, 0x00, 0x00, 0x00, 0x00, 0x00, 0x00, 0x00, 0x00, 0x00, 0x00, 0x00, 0x00, 0x00, 0x00, 0x00, 0x00, 0x00, 0x00, 0x00, 0x00,
  0x00, 0x00, 0x00, 0x00, 0x00, 0x00, 0xFE, 0xFE, 0xFE, 0xFE, 0xFE, 0xFE, 0xFE, 0x00, 0x00, 0x00, 0x00, 0x00, 0x00, 0x00, 0x00, 0x00, 0x00,
  /* , */
  0x00, 0x00, 0x00, 0x00, 0x00, 0x00, 0x00, 0x00, 0x00, 0x00, 0x00, 0x00, 0x00, 0x00, 0x00, 0x00, 0x00, 0x00, 0x00, 0x00, 0x00, 0x00, 0x00,
  0x00, 0x00, 0x00, 0x00, 0x00, 0x00, 0x00, 0x00, 0x00, 0x00, 0x00, 0x00, 0x00, 0x00, 0x00, 0x00, 0x00, 0x00, 0x00, 0x00, 0x00, 0x00, 0x00,
  0x00, 0x00, 0x00, 0x00, 0x00, 0x00, 0x00, 0xE0, 0xE0, 0xE0, 0xE0, 0xE0, 0xE0, 0x00, 0x00, 0x00, 0x00, 0x00, 0x00, 0x00, 0x00, 0x00, 0x00,
  0x00, 0x00, 0x00, 0x00, 0x00, 0x80, 0xF8, 0xFF, 0xFF, 0xFF, 0x7F, 0x0F, 0x03, 0x00, 0x00, 0x00, 0x00, 0x00, 0x00, 0x00, 0x00, 0x00, 0x00,
  /* (space) */
  0x00, 0x00, 0x00, 0x00, 0x00, 0x00, 0x00, 0x00, 0x00, 0x00, 0x00, 0x00, 0x00, 0x00, 0x00, 0x00, 0x00, 0x00, 0x00, 0x00, 0x00, 0x00, 0x00,
  0x00, 0x00, 0x00, 0x00, 0x00, 0x00, 0x00, 0x00, 0x00, 0x00, 0x00, 0x00, 0x00, 0x00, 0x00, 0x00, 0x00, 0x00, 0x00, 0x00, 0x00, 0x00, 0x00,
  0x00, 0x00, 0x00, 0x00, 0x00, 0x00, 0x00, 0x00, 0x00, 0x00, 0x00, 0x00, 0x00, 0x00, 0x00, 0x00, 0x00, 0x00, 0x00, 0x00, 0x00, 0x00, 0x00,
  0x00, 0x00, 0x00, 0x00, 0x00, 0x00, 0x00, 0x00, 0x00, 0x00, 0x00, 0x00, 0x00, 0x00, 0x00, 0x00, 0x00, 0x00, 0x00, 0x00, 0x00, 0x00, 0x00,

};

void LEDPIN_Init(void){
  /* LED_SCL_Init;
   LED_SDA_Init;
   LED_RST_Init;
   LED_DC_Init;*/
  pinMode(SCL_PIN, OUTPUT);
  pinMode(SDA_PIN, OUTPUT);
  pinMode(RST_PIN, OUTPUT);
  pinMode(DC_PIN, OUTPUT);
}

void LED_WrDat(unsigned char data){
  unsigned char i = 8;
  //LED_CS=0;
  //LED_DCH;;;
  digitalWrite(DC_PIN, HIGH);
  //LED_SCLL;;;
  digitalWrite(SCL_PIN, LOW);
  while (i--)
  {
    if (data & 0x80)
    {
      digitalWrite(SDA_PIN, HIGH);;;;
    }
    else
    {
      digitalWrite(SDA_PIN, LOW);;;
    }
    //LED_SCLH;;;
    digitalWrite(SCL_PIN, HIGH);;;
    asm("nop");;;

    //LED_SCLL;;;
    digitalWrite(SCL_PIN, LOW);
    data <<= 1;
  }
  //LED_CS=1;
}

void LED_WrCmd(unsigned char cmd){
  unsigned char i = 8;
  //LED_CS = 0;
  //LED_DCL;;;
  digitalWrite(DC_PIN, LOW);;;
  //LED_SCLL;;;
  digitalWrite(SCL_PIN, LOW);;;
  while (i--)
  {
    if (cmd & 0x80)
    {
      //LED_SDAH;;;
      digitalWrite(SDA_PIN, HIGH);;;
    }
    else
    {
      //LED_SDAL;;;
      digitalWrite(SDA_PIN, LOW);;;
    }
    //LED_SCLH;;;
    digitalWrite(SCL_PIN, HIGH);;;
    asm("nop");;;
    //LED_SCLL;;;
    digitalWrite(SCL_PIN, LOW);;;
    cmd <<= 1;
  }
  //LED_CS = 1;
}

void LED_Set_Pos(unsigned char x, unsigned char y){
  LED_WrCmd(0xb0 + y);
  LED_WrCmd(((x & 0xf0) >> 4) | 0x10);
  LED_WrCmd((x & 0x0f) | 0x00);
}

void LED_Fill(unsigned char bmp_data){
  unsigned char y, x;

  for (y = 0; y < 8; y++)
  {
    LED_WrCmd(0xb0 + y);
    LED_WrCmd(0x00);
    LED_WrCmd(0x10);
    for (x = 0; x < 128; x++)
      LED_WrDat(bmp_data);
  }
}

void LED_CLS(void){
  unsigned char y, x;
  for (y = 0; y < 8; y++)
  {
    LED_WrCmd(0xb0 + y);
    LED_WrCmd(0x00);
    LED_WrCmd(0x10);
    for (x = 0; x < 128; x++)
      LED_WrDat(0);
  }
}

void LED_DLY_ms(unsigned int ms){
  unsigned int a;
  while (ms)
  {
    a = 6675;
    while (a--);
    ms--;
  }
  return;
  //  time_delay_ms(ms);
}

void SetStartColumn(unsigned char d){
  LED_WrCmd(0x00 + d % 16);  // Set Lower Column Start Address for Page Addressing Mode
  // Default => 0x00
  LED_WrCmd(0x10 + d / 16); // Set Higher Column Start Address for Page Addressing Mode
  // Default => 0x10
}

void SetAddressingMode(unsigned char d){
  LED_WrCmd(0x20);      // Set Memory Addressing Mode
  LED_WrCmd(d);     // Default => 0x02
  // 0x00 => Horizontal Addressing Mode
  // 0x01 => Vertical Addressing Mode
  // 0x02 => Page Addressing Mode
}

void SetColumnAddress(unsigned char a, unsigned char b){
  LED_WrCmd(0x21);      // Set Column Address
  LED_WrCmd(a);     // Default => 0x00 (Column Start Address)
  LED_WrCmd(b);     // Default => 0x7F (Column End Address)
}

void SetPageAddress(unsigned char a, unsigned char b){
  LED_WrCmd(0x22);      // Set Page Address
  LED_WrCmd(a);     // Default => 0x00 (Page Start Address)
  LED_WrCmd(b);     // Default => 0x07 (Page End Address)
}

void SetStartLine(unsigned char d){
  LED_WrCmd(0x40 | d);    // Set Display Start Line
  // Default => 0x40 (0x00)
}

void SetContrastControl(unsigned char d){
  LED_WrCmd(0x81);      // Set Contrast Control
  LED_WrCmd(d);     // Default => 0x7F
}

void Set_Charge_Pump(unsigned char d){
  LED_WrCmd(0x8D);      // Set Charge Pump
  LED_WrCmd(0x10 | d);    // Default => 0x10
  // 0x10 (0x00) => Disable Charge Pump
  // 0x14 (0x04) => Enable Charge Pump
}

void Set_Segment_Remap(unsigned char d){
  LED_WrCmd(0xA0 | d);    // Set Segment Re-Map
  // Default => 0xA0
  // 0xA0 (0x00) => Column Address 0 Mapped to SEG0
  // 0xA1 (0x01) => Column Address 0 Mapped to SEG127
}

void Set_Entire_Display(unsigned char d){
  LED_WrCmd(0xA4 | d);    // Set Entire Display On / Off
  // Default => 0xA4
  // 0xA4 (0x00) => Normal Display
  // 0xA5 (0x01) => Entire Display On
}

void Set_Inverse_Display(unsigned char d){
  LED_WrCmd(0xA6 | d);    // Set Inverse Display On/Off
  // Default => 0xA6
  // 0xA6 (0x00) => Normal Display
  // 0xA7 (0x01) => Inverse Display On
}

void Set_Multiplex_Ratio(unsigned char d){
  LED_WrCmd(0xA8);      // Set Multiplex Ratio
  LED_WrCmd(d);     // Default => 0x3F (1/64 Duty)
}

void Set_Display_On_Off(unsigned char d){
  LED_WrCmd(0xAE | d);    // Set Display On/Off
  // Default => 0xAE
  // 0xAE (0x00) => Display Off
  // 0xAF (0x01) => Display On
}

void SetStartPage(unsigned char d){
  LED_WrCmd(0xB0 | d);    // Set Page Start Address for Page Addressing Mode
  // Default => 0xB0 (0x00)
}

void Set_Common_Remap(unsigned char d){
  LED_WrCmd(0xC0 | d);    // Set COM Output Scan Direction
  // Default => 0xC0
  // 0xC0 (0x00) => Scan from COM0 to 63
  // 0xC8 (0x08) => Scan from COM63 to 0
}

void Set_Display_Offset(unsigned char d){
  LED_WrCmd(0xD3);    // Set Display Offset
  LED_WrCmd(d);       // Default => 0x00
}

void Set_Display_Clock(unsigned char d){
  LED_WrCmd(0xD5);              // Set Display Clock Divide Ratio / Oscillator Frequency
  LED_WrCmd(d);                 // Default => 0x80
  // D[3:0] => Display Clock Divider
  // D[7:4] => Oscillator Frequency
}

void Set_Precharge_Period(unsigned char d){
  LED_WrCmd(0xD9);      // Set Pre-Charge Period
  LED_WrCmd(d);     // Default => 0x22 (2 Display Clocks [Phase 2] / 2 Display Clocks [Phase 1])
  // D[3:0] => Phase 1 Period in 1~15 Display Clocks
  // D[7:4] => Phase 2 Period in 1~15 Display Clocks
}

void Set_Common_Config(unsigned char d){
  LED_WrCmd(0xDA);      // Set COM Pins Hardware Configuration
  LED_WrCmd(0x02 | d);    // Default => 0x12 (0x10)
  // Alternative COM Pin Configuration
  // Disable COM Left/Right Re-Map
}

void Set_VCOMH(unsigned char d){
  LED_WrCmd(0xDB);      // Set VCOMH Deselect Level
  LED_WrCmd(d);     // Default => 0x20 (0.77*VCC)
}

void Set_NOP(void){
  LED_WrCmd(0xE3);      // Command for No Operation
}

void LED_Init(void){
  unsigned char i;
  LEDPIN_Init();
  //  LED_PORT=0X0F;
  //LED_SCLH;;;
  //LED_RSTL;;;
  digitalWrite(SCL_PIN, HIGH);;;
  digitalWrite(RST_PIN, LOW);;;
  //  for(i=0;i<100;i++)asm("nop");
  LED_DLY_ms(50);
  //LED_RSTH;;;
  digitalWrite(RST_PIN, HIGH);
  Set_Display_On_Off(0x00);   // Display Off (0x00/0x01)
  Set_Display_Clock(0x80);    // Set Clock as 100 Frames/Sec
  Set_Multiplex_Ratio(0x3F);  // 1/64 Duty (0x0F~0x3F)
  Set_Display_Offset(0x00);   // Shift Mapping RAM Counter (0x00~0x3F)
  SetStartLine(0x00);         // Set Mapping RAM Display Start Line (0x00~0x3F)
  Set_Charge_Pump(0x04);      // Enable Embedded DC/DC Converter (0x00/0x04)
  SetAddressingMode(0x02);    // Set Page Addressing Mode (0x00/0x01/0x02)
  Set_Segment_Remap(0x01);    // Set SEG/Column Mapping
  Set_Common_Remap(0x8);      // Set COM/Row Scan Direction
  Set_Common_Config(0x10);    // Set Sequential Configuration (0x00/0x10)
  SetContrastControl(0xAF);   // (0xCF) Set SEG Output Current
  Set_Precharge_Period(0xF1); // Set Pre-Charge as 15 Clocks & Discharge as 1 Clock
  Set_VCOMH(0x40);            // Set VCOM Deselect Level
  Set_Entire_Display(0x00);   // Disable Entire Display On (0x00/0x01)
  Set_Inverse_Display(0x00);  // Disable Inverse Display On (0x00/0x01)
  Set_Display_On_Off(0x01);   // Display On (0x00/0x01)
  LED_Fill(0x00);             // clear all
  LED_Set_Pos(0, 0);
}

void LED_P8x16Str(unsigned char x, unsigned char y, char ch[]){
  unsigned char c = 0, i = 0, j = 0;
  while (ch[j] != '\0')
  {
    c = ch[j] - 32;
    if (x > 120)
    {
      x = 0;
      y++;
    }
    LED_Set_Pos(x, y);
    for (i = 0; i < 8; i++)
    {
      LED_WrDat(pgm_read_byte_near(F8X16 + (c << 4) + i));
    }
    LED_Set_Pos(x, y + 1);
    for (i = 0; i < 8; i++)
    {
      LED_WrDat(pgm_read_byte_near(F8X16 + (c << 4) + i + 8));
    }
    x += 8;
    j++;
  }
}

void LED_P23x32Str(unsigned char x, unsigned char y, char *ch){
  unsigned char c = 0, i = 0, j = 0, k = 0;
  while (ch[j] != '\0')
  {
    c = ch[j] - '0';
    if (x > 120) {
      x = 0;
      y++;
    }
    
    for (k = 0; k < 4; k++) {
      LED_Set_Pos(x, y + k);
      for (i = 0; i < 23; i++) {
        LED_WrDat(pgm_read_byte_near(F23x32 + c * 23 * 4 + k * 23 + i));
      }
    }
    x += 25;
    j++;
  }
}

//para tocar continuo na explosão e intermitente durante o timer
void buzzer(){
  tone(4,3100,300);
}

//nao pode ter numero repetido
int checkRepeated(){
    bool fire = false;
    strcpy(buf_t,numbers);
    for (int i=1;i<4;i++){
      if (buf_t[0] == buf_t[i]){
        Serial.println("numbers[0] == numbers[i]");
        Serial.print("comparando ");
        Serial.print(buf_t[0]);
        Serial.print(" com ");
        Serial.println(buf_t[i]);
        fire = true;
      }
    }
    for (int k=1;k<4;k++){
      if (buf_t[1] == buf_t[k+1]){
        Serial.println("numbers[1] == numbers[i]");
        Serial.print("comparando ");
        Serial.print(buf_t[1]);
        Serial.print(" com ");
        Serial.println(buf_t[k+1]);
        fire = true;
      }
    }
    if (buf_t[2] == buf_t[3]){
      Serial.println("numbers[2] == numbers[3]");
        Serial.print("comparando ");
        Serial.print(buf_t[2]);
        Serial.print(" com ");
        Serial.println(buf_t[3]);
        fire = true;
    }
    
    for (int j=0;j<4;j++){
      numbers[j] = ' ';
    }
    
    if (fire){
      numbers[0] = ' ';
      return -1;
    }
    return 0;
}

/*
Pra chegar nesse ponto somente se ja tem uma senha armazenada. Agora eh hora de comparar o array de
senha e da entrada do usuário, para encontrar os picos e tombos.
A variavel que armazena o feedback se chama picos_e_tombos; posição 0 é picos, posição 1 é tombos.
*/
int picos(){
  int p = 0;
  for (int i=0;i<4;i++){
      if (password[i] == buf_t[i]){
        Serial.print(password[i]);
        Serial.print(" = ");
        Serial.println(buf_t[i]);
          p+=1;
      }
  }
  return p;
}

int tombos(){
    int t = 0;
    int i;
    for (i=1;i<4;i++){
        if (password[0] == buf_t[i]){
          t += 1;
        }
    }
    for (i=2;i<4;i++){
        if (password[1] == buf_t[i]){
          t += 1;
        }
    }
    for (int i=2;i>-1;i--){
      if (password[3] == buf_t[i]){
        t +=1;
      }
    }
    for (i=1; i>-1;i--){
      if (password[2] == buf_t[i]){
        t += 1;
      }
    }
    if (password[1] == password[0]){
      t +=1;
    }
    if (password[2] == buf_t[3]){
      t +=1;
    }
    return t;
}

//desativar a bomba
void disable(){
    //msg_status = "Parabens campeao";
    //por enquanto, deixando o timer congelado pra fazer "recordes"
    finished   = true;
    /*
    for (int i=0;i<3;i++){
      buzzer(200);
      delay(100);
    }
    */
}

//explodir
void explode(){
  msg_status = "Ahahahaha";
  for (int i=0;i<20;i++){
      buzzer();
      delay(502);
  }
  disable();
}

void picoOuTombo(){
  msg_status = "                ";
  int p = picos();
  int t = tombos();
  String pt = String(p) + "P" + String(t) + "T";
  Serial.print("Resultado: ");
  Serial.println(pt);
  Serial.print("password: ");
  Serial.println(password);
  Serial.print("buf_t: ");
  Serial.println(buf_t);
  pt_time    = "P" + String(p) + "T" + String(t) + "       ";
  msg_status = pt_time + time_to_show;

  if (p == 4){
    disable();
    Serial.println("Fim");
  }
}

void comparator(){
  int stat = checkRepeated();
  if (stat == -1){
    numbers[5] = 0;
    msg_status = "Num. repetidos!";
    Serial.println("Num. repetidos!");
    return;
  }

  if (!started){
    /*Se foi chamada a interrupcao de inicializacao mas ainda nao foi iniciado o jogo,
    copia a senha para a variavel password*/
    strcpy(password,buf_t);
    Serial.print("Senha copiada: ");
    Serial.println(password);
    msg_status = "                ";
    delay(50);
  }
  else{
     msg_status = "                ";
     delay(50);
     picoOuTombo();
  }
 
  numbers[5]  = '\0';
  password[5] = '\0';

  started = true;
}

int readNumberFromPotentiometer(){
    value = analogRead(POTENTIOMETER_1);
    toMap = map(value,0,1000,0,9);
    return toMap;
}

void compareWithRandom(){
  msg_status = "                ";
  delay(50);
  Serial.println("COMPARANDO");
  comparator();
}

void changeState(){
    if (locked){
      return;
    }
    locked = true;

    //se numero >3, a matriz ja pode ser comparada
    if (pos+1 > 3){
      pos = 0;
      compareWithRandom();
    }
    //senao a interrupcao foi para adicionar +1 numero
    else{
        numbers[pos] = number+48;
        pos += 1;
    }
    
    delay(1000);
    
    Serial.print("Posicao: ");
    Serial.println(pos);
    
}

void convertSecondsToTime(){
  
    int _seconds = 0;
    int _minutes = 0;
    _minutes     = timeout/60;
    
    Serial.print("minutes: ");
    Serial.println(_minutes);
    
    _seconds     = timeout - (_minutes*60);

    Serial.print("seconds: ");
    Serial.println(_seconds);
    
    String m    = String(_minutes);
    String s    = String(_seconds);

    if (m.length() < 2){
      m = "0" + m;
      Serial.println(m);
    }
    if (s.length() <2){
      s = "0" + s;
      Serial.println(s);
    }
    msg_status = "                ";
    delay(10);
    time_to_show = m+":"+s;
    msg_status = pt_time + time_to_show;
}

void counter(){
  //started se iniciou a contagem...
  if (!started){
    return;
  }
  // ... e finished se conseguiu finalizar o desafio. o started continua porque é só pro time.
  if (!finished){
      timeout -= 1;
      if (timeout < 1){
        digitalWrite(5,HIGH);
        Serial.println("explodiu");
        disable();
      }
      buzzer();
  }
  convertSecondsToTime();
}
void setup()
{
  LEDPIN_Init();
  LED_Init();
  pinMode(INTERRUPT_PIN,INPUT_PULLUP);
  pinMode(BUZZER,OUTPUT);
  pinMode(LED_PIN,OUTPUT);

  Timer1.initialize(1000000);
  Timer1.setPeriod(1000000);
  Timer1.attachInterrupt(counter);

  //interrupts();
  attachInterrupt(digitalPinToInterrupt(INTERRUPT_PIN), changeState, FALLING);
  Serial.begin(115200);
}

void loop(){
  if (finished){
    while (true){
      LED_P23x32Str(3, 3, buf_t);
      char buf_end[17];
      //msg_status = "Parabens campeao";
      msg_status.toCharArray(buf_end,17);
      delay(300);
    }
  }
  char temp_str[6];

  int temp = readNumberFromPotentiometer();
  
  if (temp != number){
    number = toMap;
    Serial.println(number);
  }
  
  if (!locked && pos < 4){
      numbers[pos] = number+48;
  }
  if (locked){
    delay(1000);
    locked =false;
  }

  if (!locked){
      LED_P23x32Str(3, 3, numbers);
  }
  char buf[17];
  msg_status.toCharArray(buf,17);
  
  LED_P8x16Str(move_offset, 0, buf);

}
